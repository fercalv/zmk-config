## boards/shields/narsil/Kconfig.defconfig
```kconfig
if SHIELD_NARSIL_LEFT

config ZMK_KEYBOARD_NAME
    default "narsil"

config ZMK_SPLIT_ROLE_CENTRAL
    default y

endif # SHIELD_NARSIL_LEFT

if SHIELD_NARSIL_LEFT || SHIELD_NARSIL_RIGHT

config ZMK_SPLIT
    default y

endif # SHIELD_NARSIL_LEFT || SHIELD_NARSIL_RIGHT
```
